## examples/test-conf/Kconfig
```kconfig
# Kconfig语法简介:
#
# Kconfig界面一般是使用空格键或回车键改变选项，ESC键退出
# Kconfig可以包含其他Kconfig文件，语法: source "文件名"


# 1. 主菜单语法
#
####################
# mainmenu "主菜单名"
####################
#
# mainmenu标志Kconfig开始，是输入make menuconfig后打开的默认界面

mainmenu "Test Configuration"


# 2. config模块语法
#
#####################
# config 配置项
#     配置项类型
#     prompt "配置项名"
#     其它选项
#####################
#
# 配置项: 决定保存在 .config 文件中的键值对的键名(CONFIG_配置项)
# 配置项类型: 决定保存在 .config 文件中的键值对的键值类型，可选的类型有 bool tristate string int hex
#     bool    : 布尔型，在.config中以 y n 表示
#     tristate: 三态型，在.config中以 y n m 表示，内核驱动中: y表示将驱动编译进内核镜像，n表示不编译，m表示将驱动编译为ko形式
#     string  : 字符串型，在.config中以 "原样" 表示
#     int     : 数字型(十进制)，在.config中以 原样 表示
#     hex     : 数字型(十六进制)，在.config中以 原样 表示
# 配置项名: 显示在界面上的配置项名称，可以和配置项类型合并写，语法: 配置项类型 "配置项名"
# 其它选项: 见子段落说明

config KCONFIG_BOOL_ITEM1
    bool
    prompt "kconfig bool item1 learning"

config KCONFIG_BOOL_ITEM2
    bool "kconfig bool item2 learning"

config KCONFIG_TRISTATE_ITEM
    tristate
    prompt "kconfig tristate item learning"

config KCONFIG_STRING_ITEM
    string
    prompt "kconfig string item learning"

config KCONFIG_INT_ITEM
    int
    prompt "kconfig int item learning"

config KCONFIG_HEX_ITEM
    hex
    prompt "kconfig hex item learning"


# 2.1 依赖项语法
#
#####################
# config 配置项
#     配置项类型
#     prompt "配置项名" if 依赖的配置项
#####################
# config 配置项
#     配置项类型
#     prompt "配置项名"
#     depends on 依赖的配置项
#####################
#
# 依赖的配置项设为 y 时，本设置项才显示

config DEPEND_BOOL_ITEM
    bool
    prompt "depends on bool item1 learning" if KCONFIG_BOOL_ITEM1

config DEPEND_STRING_ITEM
    string
    prompt "depends on bool item2 learning"
    depends on KCONFIG_BOOL_ITEM2

config DEPEND_AND_ITEM
    bool
    prompt "depends on bool item1 and item2 learning" if (KCONFIG_BOOL_ITEM1 && KCONFIG_BOOL_ITEM2)

config DEPEND_OR_ITEM
    bool
    prompt "depends on bool item1 or item2 learning"
    depends on (KCONFIG_BOOL_ITEM1 || KCONFIG_BOOL_ITEM2)


# 附: 表达式语法
#
# 一般 if / depends on / select / default 可能使用表达式语法
#####################
# 配置项              : bool 和 tristate 简单转换为相应配置项的值，其他类型转换为 n
# 配置项  = 配置项/值 : 两个配置项相等返回 y，否则返回 n, 还支持: != < <= > >=
# (表达式)            : 改变计算优先级
# ! 表达式            : 逻辑非
# 表达式 && 表达式    : 逻辑与
# 表达式 || 表达式    : 逻辑或
#####################


# 2.2 选择项语法
#
#####################
# config 配置项
#     bool
#     prompt "配置项名"
#     select 选择的配置项
#####################
#
# 设置项设置 y 时，被选择的选项也会设为 y

config SELECT_BOOL_ITEM
    bool
    prompt "select bool item1 and item2 learning"
    select KCONFIG_BOOL_ITEM1
    select KCONFIG_BOOL_ITEM2


# 2.3 默认值语法
#
#####################
# config 配置项
#     配置项类型
#     prompt "配置项名"
#     default 配置项值
#####################
#
# 给配置项默认值

config DEFAULT_BOOL_ITEM
    bool
    prompt "bool item default y learning"
    default y

config DEFAULT_STRING_ITEM
    string
    prompt "string item default lengjing learning"
    default "lengjing"

config DEFAULT_INT_ITEM
    int
    prompt "int item default 100 learning"
    default 100


# 2.4 范围值语法
#
#####################
# config 配置项
#     配置项类型
#     prompt "配置项名"
#     range 值1 值2
#####################
#
# 限制 int 和 hex 类型符号的输出值的范围

config RANGE_INT_ITEM
    int
    prompt "int item range 0~127 learning"
    range 0 127


# 2.5 帮助信息语法
#
#####################
# config 配置项
#     配置项类型
#     prompt "配置项名"
#     help
#     帮助信息语句1
#     帮助信息语句2
#####################
#
# 移动到该配置项后，按大写H键显示帮助信息

config HELP_BOOL_ITEM
    bool
    prompt "item help information learning"
    help
    This item has help information,
    It is a bool item.


# 2.6 注释信息语法
#
#####################
# comment "注释信息"
#####################
#
# 注释信息会在界面显示，也会在.config中写入

comment "comment item learning"


# 3. menu模块语法
#
#####################
# menu "配置项名"
#
# 子配置模块1
#
# ...
#
# 子配置模块n
#
# endmenu
#####################
#
# 移动到menu配置项后，按回车键可以进入子菜单界面
# menu配置项名会在.config中作为注释写入

menu "menu item learning"

config MENU_BOOL_SUBITEM
    bool
    prompt "bool subitem in menu learning"

config MENU_STRING_SUBITEM
    string
    prompt "string subitem in menu learning"

endmenu


# 4. menuconfig模块语法
#
#####################
# menuconfig 配置项
#     bool
#     prompt "配置项名"
#     其它选项
#
# if 配置项
#
# 子配置模块1
#
# ...
#
# 子配置模块n
#
# endif
#####################
#
# 空格键选中menuconfig配置项后，按回车键可以进入子菜单界面

menuconfig MENUCONFIG_ITEM
    bool
    prompt "menuconfig item learning"

if MENUCONFIG_ITEM

config MENUCONFIG_BOOL_SUBITEM
    bool
    prompt "bool subitem in menuconfig learning"

config MENUCONFIG_STRING_SUBITEM
    string
    prompt "string subitem in menuconfig learning"

endif


# 5. choice模块语法
#
#####################
# choice 配置项
#     prompt "配置项名"
#     其它选项
#
# bool子配置模块1
#
# ...
#
# bool子配置模块n
#
# endchoice
#####################
#
# 移动到choice配置项后，按回车键可以进入子菜单界面

choice CHOICE_ITEM
    prompt "choice item learning"
    default CHOICE_SUBITEM2

config CHOICE_SUBITEM1
    bool
    prompt "choice subitem1"

config CHOICE_SUBITEM2
    bool
    prompt "choice subitem2"

endchoice


# 6. Kconfig变量和函数
#
# 变量或函数定义
######################
# val := value                 : 简单扩展变量，读到该行时，它的右边立刻扩展
# val  = value                 : 递归扩展变量，当变量使用时才真正扩展
# val += value                 : 向变量追加文本，不改变符号的扩展属性
######################
#
# 调用变量
######################
# $(val)                       : 调用变量
######################
#
# 调用函数
######################
# $(call func,arg1,arg2...)    : 调用函数，逗号之间无空格，调用内建函数省略call
######################
#
# 内建函数
######################
# $(shell,command)             : 扩展为执行的子命令command的标准输出
# $(info,text)                 : 发送一段文本text到标准输出
# $(warning-if,condition,text) : 如果条件为真，则发送文本text和当前Kconfig文件名以及行号到错误输出
# $(error-if,condition,text)   : 如果条件为真，则发送文本text和当前Kconfig文件名以及行号到错误输出，并立刻终止解析
# $(filename)                  : 扩展为被解析的文件名
# $(lineno)                    : 扩展为被解析的行号
#####################
```
